## boards/shields/mono_guacamole/Kconfig.defconfig
```kconfig
if SHIELD_MONO_GUACAMOLE

config ZMK_KEYBOARD_NAME
    default "Mono Guacamole"

endif
```

## boards/shields/mono_guacamole/Kconfig.shield
```kconfig
config SHIELD_MONO_GUACAMOLE
    def_bool $(shields_list_contains,mono_guacamole)
```
